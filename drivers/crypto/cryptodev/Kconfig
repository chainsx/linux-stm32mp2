## drivers/crypto/cryptodev/Kconfig
```kconfig
# SPDX-License-Identifier: GPL-2.0-only
config CRYPTO_DEV_CRYPTODEV
	tristate "cryptodev-linux crypto driver"
	help
	  This driver provides support for cryptodev-linux crypto device.
```

## drivers/gpu/drm/gcnano/Kconfig
```kconfig
# SPDX-License-Identifier: GPL-2.0

config DRM_GCNANO
	tristate "GCnano (DRM support for GCnano GPUs)"
	depends on DRM
	depends on ARM || ARM64 || COMPILE_TEST
	depends on !GENERIC_ATOMIC64    # for IOMMU_IO_PGTABLE_LPAE
	depends on MMU
	select DRM_SCHED
	select IOMMU_SUPPORT
	select IOMMU_IO_PGTABLE_LPAE
	select DRM_GEM_SHMEM_HELPER
	select PM_DEVFREQ
	select DEVFREQ_GOV_SIMPLE_ONDEMAND
	select WANT_DEV_COREDUMP
	help
	  DRM driver for GCnano GPUs.
```

## drivers/misc/tttech-tsn/acm/Kconfig
```kconfig
# SPDX-License-Identifier: GPL-2.0-only
config TTTECH_TSN_NGN_ACM
	tristate "ngn acm driver"
	help
	  This driver provides support for TTTech ngn acm device.
```

## drivers/misc/tttech-tsn/edge-lkm/Kconfig
```kconfig
# SPDX-License-Identifier: GPL-2.0-only
config TTTECH_TSN_EDGEX_PFM_LKM
	tristate "edgex pfm lkm driver"
	help
	  This driver provides support for edgex pfm lkm device.
```

## drivers/misc/tttech-tsn/stm32-deip/Kconfig
```kconfig
# SPDX-License-Identifier: GPL-2.0-only
config TTTECH_TSN_STM32_DEIP
	tristate "stm32 deip driver"
	help
	  This driver provides support for stm32 deip device.
```
